## Documentation/devicetree/bindings/interconnect/qcom,msm8998.yaml
```yaml
# SPDX-License-Identifier: (GPL-2.0 OR BSD-2-Clause)
%YAML 1.2
---
$id: http://devicetree.org/schemas/interconnect/qcom,msm8998.yaml#
$schema: http://devicetree.org/meta-schemas/core.yaml#

title: Qualcomm MSM8998 Network-On-Chip interconnect

maintainers:
  - AngeloGioacchino Del Regno <angelogioacchino.delregno@somainline.org>
  - Konrad Dybcio <konrad.dybcio@somainline.org>

description: |
  The Qualcomm MSM8998 interconnect providers support adjusting the
  bandwidth requirements between the various NoC fabrics.

properties:
  reg:
    maxItems: 1

  compatible:
    enum:
      - qcom,msm8998-a1noc
      - qcom,msm8998-a2noc
      - qcom,msm8998-bimc
      - qcom,msm8998-cnoc
      - qcom,msm8998-gnoc
      - qcom,msm8998-mnoc
      - qcom,msm8998-snoc

  '#interconnect-cells':
    const: 1

  clocks:
    minItems: 1
    maxItems: 3

  clock-names:
    minItems: 1
    maxItems: 3

required:
  - compatible
  - reg
  - '#interconnect-cells'
  - clock-names
  - clocks

additionalProperties: false

allOf:
  - if:
      properties:
        compatible:
          contains:
            enum:
              - qcom,msm8998-mnoc
    then:
      properties:
        clocks:
          items:
            - description: Bus Clock.
            - description: Bus A Clock.
            - description: CPU-NoC High-performance Bus Clock.
        clock-names:
          items:
            - const: bus
            - const: bus_a
            - const: iface

  - if:
      properties:
        compatible:
          contains:
            enum:
              - qcom,msm8998-a2noc
              - qcom,msm8998-bimc
              - qcom,msm8998-cnoc
              - qcom,msm8998-gnoc
              - qcom,msm8998-snoc
    then:
      properties:
        clocks:
          items:
            - description: Bus Clock.
            - description: Bus A Clock.
        clock-names:
          items:
            - const: bus
            - const: bus_a

examples:
  - |
      #include <dt-bindings/clock/qcom,rpmcc.h>
      #include <dt-bindings/clock/qcom,mmcc-msm8998.h>

      bimc: interconnect@1008000 {
              compatible = "qcom,msm8998-bimc";
              reg = <0x01008000 0x78000>;
              #interconnect-cells = <1>;
              clock-names = "bus", "bus_a";
              clocks = <&rpmcc RPM_SMD_BIMC_CLK>,
                       <&rpmcc RPM_SMD_BIMC_A_CLK>;
      };

      cnoc: interconnect@1500000 {
              compatible = "qcom,msm8998-cnoc";
              reg = <0x01500000 0x10000>;
              #interconnect-cells = <1>;
              clock-names = "bus", "bus_a";
              clocks = <&rpmcc RPM_SMD_CNOC_CLK>,
                       <&rpmcc RPM_SMD_CNOC_A_CLK>;
      };

      snoc: interconnect@1625000 {
              compatible = "qcom,msm8998-snoc";
              reg = <0x01625000 0x6100>;
              #interconnect-cells = <1>;
              clock-names = "bus", "bus_a";
              clocks = <&rpmcc RPM_SMD_SNOC_CLK>,
                       <&rpmcc RPM_SMD_SNOC_A_CLK>;
      };

      a1noc: interconnect@1669000 {
              compatible = "qcom,msm8998-a1noc";
              reg = <0x01669000 0x5020>;
              #interconnect-cells = <1>;
              clock-names = "bus", "bus_a";
              clocks = <&rpmcc RPM_SMD_AGGR1_NOC_CLK>,
                       <&rpmcc RPM_SMD_AGGR1_NOC_A_CLK>;
      };

      a2noc: interconnect@1705000 {
              compatible = "qcom,msm8998-a2noc";
              reg = <0x01705000 0xa090>;
              #interconnect-cells = <1>;
              clock-names = "bus", "bus_a";
              clocks = <&rpmcc RPM_SMD_AGGR2_NOC_CLK>,
                       <&rpmcc RPM_SMD_AGGR2_NOC_A_CLK>;
      };

      mnoc: interconnect@1744000 {
              compatible = "qcom,msm8998-mnoc";
              reg = <0x01744000 0xb010>;
              #interconnect-cells = <1>;
              clock-names = "bus", "bus_a", "iface";
              clocks = <&rpmcc RPM_SMD_MMAXI_CLK>,
                       <&rpmcc RPM_SMD_MMAXI_A_CLK>,
                       <&mmcc AHB_CLK_SRC>;
      };

      gnoc: interconnect@17900000 {
              compatible = "qcom,msm8998-gnoc";
              reg = <0x17900000 0xe000>;
              #interconnect-cells = <1>;
              clock-names = "bus", "bus_a";
              clocks = <&xo_board>, <&xo_board>;
      };
```

## Documentation/devicetree/bindings/media/i2c/sony,imx300.yaml
```yaml
# SPDX-License-Identifier: (GPL-2.0-only OR BSD-2-Clause)
%YAML 1.2
---
$id: http://devicetree.org/schemas/media/i2c/sony,imx300.yaml#
$schema: http://devicetree.org/meta-schemas/core.yaml#

title: Sony 1/2.3-Inch 25Mpixel Stacked CMOS Digital Image Sensor

maintainers:
  - AngeloGioacchino Del Regno <angelogioacchino.delregno@somainline.org>

description: |-
  The Sony IMX300 is a 1/2.3-inch Stacked CMOS (Exmor-RS) digital image
  sensor with a pixel size of 1.08um and an active array size of
  5948H x 4140V. It is programmable through I2C interface at address 0x10.
  Image data is sent through MIPI CSI-2, which is configured as either 2 or
  4 data lanes.

properties:
  compatible:
    const: sony,imx300

  reg:
    maxItems: 1

  clocks:
    maxItems: 1

  vdig-supply:
    description:
      Digital I/O voltage supply, 1.15-1.20 volts

  vana-supply:
    description:
      Analog voltage supply, 2.2 volts

  vddl-supply:
    description:
      Digital core voltage supply, 1.8 volts

  reset-gpios:
    description: |-
      Reference to the GPIO connected to the xclr pin, if any.
      Must be released (set high) after all supplies are applied.

  # See ../video-interfaces.txt for more details
  port:
    type: object
    properties:
      endpoint:
        type: object

        properties:
          data-lanes:
            description: |-
              The driver only supports four-lane operation.
            items:
              - const: 0
              - const: 1
              - const: 2
              - const: 3

          clock-noncontinuous: true

          link-frequencies:
            $ref: /schemas/types.yaml#/definitions/uint64-array
            description:
              Allowed data bus frequencies. The driver currently needs
              to switch between 780000000 and 480000000 Hz in order to
              guarantee functionality of all modes.

        required:
          - data-lanes
          - link-frequencies

required:
  - compatible
  - reg
  - clocks
  - vana-supply
  - vdig-supply
  - vddl-supply
  - port

additionalProperties: false

examples:
  - |
    i2c0 {
        #address-cells = <1>;
        #size-cells = <0>;

        imx300: sensor@10 {
            compatible = "sony,imx300";
            reg = <0x10>;
            clocks = <&imx300_xclk>;
            vana-supply = <&imx300_vana>;   /* 2.2v */
            vdig-supply = <&imx300_vdig>;   /* 1.2v */
            vddl-supply = <&imx300_vddl>;   /* 1.8v */

            port {
                imx300_0: endpoint {
                    remote-endpoint = <&csi1_ep>;
                    data-lanes = <0 1 2 3>;
                    clock-noncontinuous;
                    link-frequencies = /bits/ 64 <780000000 480000000>;
                };
            };
        };
    };

...
```

## Documentation/devicetree/bindings/media/qcom,sdm660-venus.yaml
```yaml
# SPDX-License-Identifier: (GPL-2.0 OR BSD-2-Clause)

%YAML 1.2
---
$id: "http://devicetree.org/schemas/media/qcom,sdm660-venus.yaml#"
$schema: "http://devicetree.org/meta-schemas/core.yaml#"

title: Qualcomm Venus video encode and decode accelerators

maintainers:
  - Stanimir Varbanov <stanimir.varbanov@linaro.org>

description: |
  The Venus IP is a video encode and decode accelerator present
  on Qualcomm platforms

properties:
  compatible:
    const: qcom,sdm660-venus

  reg:
    maxItems: 1

  interrupts:
    maxItems: 1

  clocks:
    maxItems: 5

  clock-names:
    items:
      - const: core
      - const: iface
      - const: bus
      - const: bus_throttle
      - const: vcodec0_core

  interconnects:
    maxItems: 2

  interconnect-names:
    items:
      - const: video-mem
      - const: cpu-cfg

  iommus:
    maxItems: 20

  memory-region:
    maxItems: 1

  power-domains:
    minItems: 3

  power-domain-names:
    items:
      - const: cx
      - const: vcodec0
      - const: venus

  video-decoder:
    type: object

    properties:
      compatible:
        const: venus-decoder

    required:
      - compatible

    additionalProperties: false

  video-encoder:
    type: object

    properties:
      compatible:
        const: venus-encoder

    required:
      - compatible

    additionalProperties: false

  video-firmware:
    type: object

    description: |
      Firmware subnode is needed when the platform does not
      have TrustZone.

    properties:
      iommus:
        maxItems: 2

    required:
      - iommus

required:
  - compatible
  - reg
  - interrupts
  - power-domains
  - power-domain-names
  - clocks
  - clock-names
  - iommus
  - memory-region
  - video-decoder
  - video-encoder

additionalProperties: false

examples:
  - |
        #include <dt-bindings/interrupt-controller/arm-gic.h>
        #include <dt-bindings/clock/qcom,mmcc-sdm660.h>
        #include <dt-bindings/power/qcom-rpmpd.h>

        video-codec@cc00000 {
                compatible = "qcom,sdm660-venus";
                reg = <0x0cc00000 0xff000>;
                interrupts = <GIC_SPI 287 IRQ_TYPE_LEVEL_HIGH>;
                power-domains = <&rpmpd SDM660_VDDCX>,
                                <&mmcc VENUS_CORE0_GDSC>,
                                <&mmcc VENUS_GDSC>;
                power-domain-names = "cx", "vcodec0", "venus";
                clocks = <&mmcc VIDEO_CORE_CLK>,
                         <&mmcc VIDEO_AHB_CLK>,
                         <&mmcc VIDEO_AXI_CLK>,
                         <&mmcc THROTTLE_VIDEO_AXI_CLK>,
                         <&mmcc VIDEO_SUBCORE0_CLK>;
                clock-names = "core", "iface", "bus", "bus_throttle",
                              "vcodec0_core";
                iommus = <&mmss_smmu 0x400>,
                         <&mmss_smmu 0x401>,
                         <&mmss_smmu 0x40a>,
                         <&mmss_smmu 0x407>,
                         <&mmss_smmu 0x40e>,
                         <&mmss_smmu 0x40f>,
                         <&mmss_smmu 0x408>,
                         <&mmss_smmu 0x409>,
                         <&mmss_smmu 0x40b>,
                         <&mmss_smmu 0x40c>,
                         <&mmss_smmu 0x40d>,
                         <&mmss_smmu 0x410>,
                         <&mmss_smmu 0x421>,
                         <&mmss_smmu 0x428>,
                         <&mmss_smmu 0x429>,
                         <&mmss_smmu 0x42b>,
                         <&mmss_smmu 0x42c>,
                         <&mmss_smmu 0x42d>,
                         <&mmss_smmu 0x411>,
                         <&mmss_smmu 0x431>;
                memory-region = <&venus_region>;

                video-decoder {
                        compatible = "venus-decoder";
                };

                video-encoder {
                        compatible = "venus-encoder";
                };
        };
```

## Documentation/devicetree/bindings/pinctrl/awinic,aw9523-pinctrl.yaml
```yaml
# SPDX-License-Identifier: (GPL-2.0-only OR BSD-2-Clause)
%YAML 1.2
---
$id: http://devicetree.org/schemas/pinctrl/awinic,aw9523-pinctrl.yaml#
$schema: http://devicetree.org/meta-schemas/core.yaml#

title: Awinic AW9523/AW9523B I2C GPIO Expander

maintainers:
  - AngeloGioacchino Del Regno <angelogioacchino.delregno@somainline.org>

description: |
  The Awinic AW9523/AW9523B I2C GPIO Expander featuring 16 multi-function
  I/O, 256 steps PWM mode and interrupt support.

properties:
  compatible:
    const: awinic,aw9523-pinctrl

  reg:
    maxItems: 1

  '#gpio-cells':
    description: |
      Specifying the pin number and flags, as defined in
      include/dt-bindings/gpio/gpio.h
    const: 2

  gpio-controller: true

  gpio-ranges:
    maxItems: 1

  interrupt-controller: true

  interrupts:
    maxItems: 1
    description: Specifies the INTN pin IRQ.

  '#interrupt-cells':
    description:
      Specifies the PIN numbers and Flags, as defined in defined in
      include/dt-bindings/interrupt-controller/irq.h
    const: 2

#PIN CONFIGURATION NODES
patternProperties:
  '^.*$':
    if:
      type: object
    then:
      properties:
        pins:
          description:
            List of gpio pins affected by the properties specified in
            this subnode.
          items:
            pattern: "^gpio([0-9]|1[0-5])$"
          minItems: 1
          maxItems: 16

        function:
          description:
            Specify the alternative function to be configured for the
            specified pins.

          enum: [ gpio, pwm ]

        bias-disable: true
        bias-pull-down: true
        bias-pull-up: true
        drive-open-drain: true
        drive-push-pull: true
        input-enable: true
        output-high: true
        output-low: true

      required:
        - pins
        - function

      additionalProperties: false

required:
  - compatible
  - reg
  - gpio-controller
  - '#gpio-cells'
  - gpio-ranges

additionalProperties: false

examples:
  - |
    #include <dt-bindings/gpio/gpio.h>
    #include <dt-bindings/interrupt-controller/irq.h>

    i2c_node {
        gpio-expander@58 {
                compatible = "awinic,aw9523-pinctrl";
                reg = <0x58>;
	         interrupt-parent = <&tlmm>;
                interrupts = <50 IRQ_TYPE_EDGE_FALLING>;
                gpio-controller;
                #gpio-cells = <2>;
                gpio-ranges = <&tlmm 0 0 16>;
                interrupt-controller;
                #interrupt-cells = <2>;
	         reset-gpios = <&tlmm 51 GPIO_ACTIVE_HIGH>;
        };
    };
```
