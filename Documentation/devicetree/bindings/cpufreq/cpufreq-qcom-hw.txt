## Documentation/devicetree/bindings/cpufreq/qcom,cpufreq-hw.yaml
```yaml
# SPDX-License-Identifier: (GPL-2.0 OR BSD-2-Clause)
%YAML 1.2
---
$id: "http://devicetree.org/schemas/cpufreq/qcom,cpufreq-hw.yaml#"
$schema: "http://devicetree.org/meta-schemas/core.yaml#"

title: Qualcomm Technologies, Inc. CPUFREQ HW

description: |
  CPUFREQ HW is a hardware engine used by some Qualcomm Technologies, Inc. (QTI)
  SoCs to manage frequency in hardware. It is capable of controlling frequency
  for multiple clusters.

maintainers:
  - TBD

properties:
  compatible:
    items:
      - enum:
          - qcom,cpufreq-hw
          - qcom,cpufreq-hw-8998
          - qcom,cpufreq-epss

  reg:
    description: Base addresses and sizes of the RBCPR register regions
    minItems: 2
    maxItems: 6

  reg-names:
    description:
      Frequency domain, osm domain and osm acd register regions for each
      domain.
    minItems: 2
    maxItems: 6
      items:
        - const: "freq-domain0"
        - const: "freq-domain1"
        - const: "freq-domain2"
        - const: "osm-acd0"
        - const: "osm-acd1"
        - const: "osm-domain0"
        - const: "osm-domain1"

  clock-names:
    minItems: 2
    maxItems: 2
    - const: xo
    - const: ref

  clocks:
    maxItems: 2

  '#freq-domain-cells':
    description: Number of cells in a freqency domain specifier.
    const: 1

  operating-points-v2: true

  qcom,freq-domain:
    $ref: '/schemas/types.yaml#/definitions/phandle'
    description: |
      Devices supporting freq-domain must set their "qcom,freq-domain"
      property with phandle to a cpufreq_hw followed by the Domain ID
      in the CPU DT node.

allOf:
 - if:
     properties:
       reg-names:
         contains:
           const: qcom,cpufreq-hw-8998
   then:
     properties:
       reg:
         minItems: 4
         maxItems: 6
       reg-names:
         items:
           minItems: 4
   else:
     properties:
       reg:
         minItems: 2
       reg-names:
         items:
           minItems: 1

required:
  - compatible
  - reg
  - reg-names
  - clock-names
  - clocks
  - "#freq-domain-cells"

additionalProperties: false

examples:
  - |
    // Example 1: Dual-cluster, Quad-core per cluster. CPUs within a
    //            cluster switch DCVS state together.

    #include <dt-bindings/clock/qcom,rpmh.h>
    #include <dt-bindings/clock/qcom,gcc-sc7180.h>

    cpus {
        #address-cells = <2>;
        #size-cells = <0>;

        CPU0: cpu@0 {
            device_type = "cpu";
            compatible = "qcom,kryo385";
            reg = <0x0 0x0>;
            enable-method = "psci";
            next-level-cache = <&L2_0>;
            qcom,freq-domain = <&cpufreq_hw 0>;
            L2_0: l2-cache {
                compatible = "cache";
                next-level-cache = <&L3_0>;
                L3_0: l3-cache {
                      compatible = "cache";
                };
            };
        };

        CPU1: cpu@100 {
            device_type = "cpu";
            compatible = "qcom,kryo385";
            reg = <0x0 0x100>;
            enable-method = "psci";
            next-level-cache = <&L2_100>;
            qcom,freq-domain = <&cpufreq_hw 0>;
            L2_100: l2-cache {
                compatible = "cache";
                next-level-cache = <&L3_0>;
            };
        };

        CPU2: cpu@200 {
            device_type = "cpu";
            compatible = "qcom,kryo385";
            reg = <0x0 0x200>;
            enable-method = "psci";
            next-level-cache = <&L2_200>;
            qcom,freq-domain = <&cpufreq_hw 0>;
            L2_200: l2-cache {
                compatible = "cache";
                next-level-cache = <&L3_0>;
            };
        };

        CPU3: cpu@300 {
            device_type = "cpu";
            compatible = "qcom,kryo385";
            reg = <0x0 0x300>;
            enable-method = "psci";
            next-level-cache = <&L2_300>;
            qcom,freq-domain = <&cpufreq_hw 0>;
            L2_300: l2-cache {
                compatible = "cache";
                next-level-cache = <&L3_0>;
            };
        };

        CPU4: cpu@400 {
            device_type = "cpu";
            compatible = "qcom,kryo385";
            reg = <0x0 0x400>;
            enable-method = "psci";
            next-level-cache = <&L2_400>;
            qcom,freq-domain = <&cpufreq_hw 1>;
            L2_400: l2-cache {
                compatible = "cache";
                next-level-cache = <&L3_0>;
            };
        };

        CPU5: cpu@500 {
            device_type = "cpu";
            compatible = "qcom,kryo385";
            reg = <0x0 0x500>;
            enable-method = "psci";
            next-level-cache = <&L2_500>;
            qcom,freq-domain = <&cpufreq_hw 1>;
            L2_500: l2-cache {
                compatible = "cache";
                next-level-cache = <&L3_0>;
            };
        };

        CPU6: cpu@600 {
            device_type = "cpu";
            compatible = "qcom,kryo385";
            reg = <0x0 0x600>;
            enable-method = "psci";
            next-level-cache = <&L2_600>;
            qcom,freq-domain = <&cpufreq_hw 1>;
            L2_600: l2-cache {
                compatible = "cache";
                next-level-cache = <&L3_0>;
            };
        };

        CPU7: cpu@700 {
            device_type = "cpu";
            compatible = "qcom,kryo385";
            reg = <0x0 0x700>;
            enable-method = "psci";
            next-level-cache = <&L2_700>;
            qcom,freq-domain = <&cpufreq_hw 1>;
            L2_700: l2-cache {
                compatible = "cache";
                next-level-cache = <&L3_0>;
            };
        };
    };

    soc {
        cpufreq_hw: cpufreq@17d43000 {
            compatible = "qcom,cpufreq-hw";
            reg = <0x17d43000 0x1400>, <0x17d45800 0x1400>;
            reg-names = "freq-domain0", "freq-domain1";

            clocks = <&rpmhcc RPMH_CXO_CLK>, <&gcc GPLL0>;
            clock-names = "xo", "alternate";

            #freq-domain-cells = <1>;
    };
...
```

## Documentation/devicetree/bindings/crypto/qcom-qce.yaml
```yaml
# SPDX-License-Identifier: GPL-2.0
%YAML 1.2
---
$id: http://devicetree.org/schemas/crypto/qcom-qce.yaml#
$schema: http://devicetree.org/meta-schemas/core.yaml#

title: Qualcomm crypto engine driver

maintainers:
  - /* Missing data * /

properties:
  compatible:
    enum:
      - qcom,crypto-v5.1
      - qcom,crypto-v5.3.4

  reg:
    maxItems: 1

  clocks:
    items:
      - description: Interface clock
      - description: Bus clock
      - description: Core clock
    minItems: 3
    maxItems: 3

  clock-names:
    items:
      - const: iface
      - const: bus
      - const: core
    minItems: 3
    maxItems: 3

  dmas:
    items:
      - description: TX DMA Channel
      - description: RX DMA Channel

  dma-names:
    items:
      - const: tx
      - const: rx

required:
  - compatible
  - reg
  - clocks
  - clock-names
  - dmas
  - dma-names

additionalProperties: false

examples:
  - |
    @fd45a000 {
      compatible = "qcom,crypto-v5.1";
      reg = <0xfd45a000 0x6000>;
      clocks = <&gcc GCC_CE2_AHB_CLK>,
          <&gcc GCC_CE2_AXI_CLK>,
          <&gcc GCC_CE2_CLK>;
      clock-names = "iface", "bus", "core";
      dmas = <&cryptobam 2>, <&cryptobam 3>;
      dma-names = "rx", "tx";
	};
```

## Documentation/devicetree/bindings/i2c/qcom,i2c-qup.yaml
```yaml
# SPDX-License-Identifier: (GPL-2.0 OR BSD-2-Clause)
%YAML 1.2
---

$id: http://devicetree.org/schemas/i2c/qcom,i2c-qup.yaml#
$schema: http://devicetree.org/meta-schemas/core.yaml#

title: Qualcomm Universal Peripheral (QUP) I2C controller

maintainers:
  - Andy Gross <agross@kernel.org>
  - Bjorn Andersson <bjorn.andersson@linaro.org>

description: Binding for Qualcomm "QUP" I2C controllers

allOf:
  - $ref: /schemas/i2c/i2c-controller.yaml#

properties:
  compatible:
    enum:
      - qcom,i2c-qup-v1.1.1
      - qcom,i2c-qup-v2.1.1
      - qcom,i2c-qup-v2.2.1

  reg:
    items:
      - description: QUP I2C register iospace

  clocks:
    items:
      - description: Core QUP I2C clock
      - description: AHB clock

  clock-names:
    items:
      - const: core
      - const: iface

  clock-frequency:
    minimum: 100000
    maximum: 1000000
    default: 100000

  dmas:
    items:
      - description: RX DMA Channel phandle
      - description: TX DMA Channel phandle

  dma-names:
    items:
      - const: rx
      - const: tx

  '#address-cells':
    const: 1

  '#size-cells':
    const: 0

required:
  - compatible
  - clocks
  - clock-names
  - reg

unevaluatedProperties: false

examples:
  - |
    #include <dt-bindings/clock/qcom,gcc-msm8998.h>
    #include <dt-bindings/gpio/gpio.h>
    #include <dt-bindings/interrupt-controller/arm-gic.h>

    i2c@c175000 {
        compatible = "qcom,i2c-qup-v2.2.1";
        reg = <0x0c175000 0x600>;
        interrupts = <GIC_SPI 95 IRQ_TYPE_LEVEL_HIGH>;
        clocks = <&gcc GCC_BLSP1_QUP1_I2C_APPS_CLK>,
                 <&gcc GCC_BLSP1_AHB_CLK>;
        clock-names = "core", "iface";
        clock-frequency = <400000>;
        dmas = <&blsp_dma 4>, <&blsp_dma 5>;
        dma-names = "rx", "tx";
        #address-cells = <1>;
        #size-cells = <0>;
    };
```

## Documentation/devicetree/bindings/input/gpio-fastmatrix-keyboard.yaml
```yaml
# SPDX-License-Identifier: (GPL-2.0-only OR BSD-2-Clause)
%YAML 1.2
---
$id: http://devicetree.org/schemas/input/gpio-fastmatrix-keyboard.yaml#
$schema: http://devicetree.org/meta-schemas/core.yaml#

title: Fast modern GPIO-driven keyboard/keypad matrix driver binding

maintainers:
  - AngeloGioacchino Del Regno <angelogioacchino.delregno@somainline.org>

description: |
  A simple common binding for matrix-connected keyboards/keypads, targeted at
  defining the keys in the scope of linux key codes since that is a stable and
  standardized interface at this time.
  This driver uses the GPIOD API in order to support setting (and reading) an
  entire array of GPIOs which is very fast (if the controller supports it) and
  a requirement to support full keyboard matrices on slow external GPIO I2C
  expanders, but also a great latency enhancement for faster GPIO controllers.

properties:
  linux,keymap:
    $ref: '/schemas/types.yaml#/definitions/uint32-array'
    description: |
      An array of packed 1-cell entries containing the equivalent of row,
      column and linux key-code as specified in dt-bindings/input/input.h

  autorescan-ms:
    $ref: /schemas/types.yaml#/definitions/uint32
    description: |
      Activates auto-rescanning of the matrix after receiving and processing
      an event for quirky hardware that won't re-send interrupts on fast-press,
      fast-depress, or multiple keys pressed events.
      This time is expressed in milliseconds; if not specified, the feature is
      disabled.

  col-scan-delay-us:
    $ref: /schemas/types.yaml#/definitions/uint32
    description: |
      Time to wait in microseconds for scan after activating a column.
      If not specified, the default is 0 (no wait).

  debounce-delay-ms:
    $ref: /schemas/types.yaml#/definitions/uint32
    description: |
      Matrix button debouncing interval time in milliseconds.
      If not specified, debouncing is disabled.

  drive-inactive-cols:
    type: boolean
    description: Keep direction of inactive columns as output

  keypad,num-rows:
    $ref: /schemas/types.yaml#/definitions/uint32
    description: Number of row lines connected to the keypad controller.

  keypad,num-columns:
    $ref: /schemas/types.yaml#/definitions/uint32
    description: Number of column lines connected to the keypad controller.

additionalProperties: true

examples:
  - |
    #include <dt-bindings/gpio/gpio.h>
    #include <dt-bindings/input/input.h>

    gpio-keyboard {
        compatible = "gpio-fastmatrix-keyboard";
        label = "Keyboard over I2C Expander"
        row-gpios =
          <&gpioext0 0 (GPIO_ACTIVE_LOW | GPIO_OPEN_DRAIN)>,
          <&gpioext0 1 (GPIO_ACTIVE_LOW | GPIO_OPEN_DRAIN)>,
          <&gpioext0 2 (GPIO_ACTIVE_LOW | GPIO_OPEN_DRAIN)>,
          <&gpioext0 3 (GPIO_ACTIVE_LOW | GPIO_OPEN_DRAIN)>,
          <&gpioext0 4 (GPIO_ACTIVE_LOW | GPIO_OPEN_DRAIN)>,
          <&gpioext0 5 (GPIO_ACTIVE_LOW | GPIO_OPEN_DRAIN)>,
          <&gpioext0 6 (GPIO_ACTIVE_LOW | GPIO_OPEN_DRAIN)>,
          <&gpioext0 7 (GPIO_ACTIVE_LOW | GPIO_OPEN_DRAIN)>;
        col-gpios =
          <&gpioext0 8 GPIO_ACTIVE_LOW>,
          <&gpioext0 9 GPIO_ACTIVE_LOW>,
          <&gpioext0 10 GPIO_ACTIVE_LOW>,
          <&gpioext0 11 GPIO_ACTIVE_LOW>,
          <&gpioext0 12 GPIO_ACTIVE_LOW>,
          <&gpioext0 13 GPIO_ACTIVE_LOW>,
          <&gpioext0 14 GPIO_ACTIVE_LOW>,
          <&gpioext0 15 GPIO_ACTIVE_LOW>;

        linux,keymap = <
          MATRIX_KEY(0, 0, KEY_F1) MATRIX_KEY(1, 0, KEY_H)
          MATRIX_KEY(2, 0, KEY_B)  MATRIX_KEY(3, 0, KEY_7)
          /* ... */
        >;

        keypad,num-rows = <8>;
        keypad,num-columns = <8>;
    };
```

## Documentation/devicetree/bindings/input/touchscreen/novatek,nt36xxx.yaml
```yaml
# SPDX-License-Identifier: GPL-2.0
%YAML 1.2
---
$id: http://devicetree.org/schemas/input/touchscreen/novatek,nt36xxx.yaml#
$schema: http://devicetree.org/meta-schemas/core.yaml#

title: Novatek NT36xxx series touchscreen controller Bindings

maintainers:
  - TBD

allOf:
  - $ref: touchscreen.yaml#

properties:
  compatible:
    enum:
      - novatek,NVT-ts

  reg:
    enum: [ 0x62 ]

  irq-gpio:
    description: GPIO pin used for IRQ. The driver uses the interrupt gpio pin
      as output to reset the device.
    maxItems: 1

  reset-gpio:
    maxItems: 1

  vddio-reg-name:
    description: Power supply regulator on VDDIO pin

  lab-reg-name:
    description: Power supply regulator on LAB pin

  ibb-reg-name:
    description: Power supply regulator on IBB pin

additionalProperties: false

required:
  - compatible
  - reg
  - irq-gpio

examples:
  - |
    i2c {
      #address-cells = <1>;
      #size-cells = <0>;
      novatek@62 {
        compatible = "novatek,nt36xxx";
        reg = <0x62>;
        reset-gpio = <&msm_gpio 102 0x00>;
        irq-gpio = <&msm_gpio 65 0x2001>;
      };
    };

...
```
